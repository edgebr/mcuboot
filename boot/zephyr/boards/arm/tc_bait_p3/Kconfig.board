## boot/zephyr/boards/arm/tc_bait_p3/Kconfig.board
```kconfig
# Kconfig - Trucks Control Bait P3 board with STM32F091CC MCU configuration
#
# Copyright (c) 2018 Trucks Control
#
#

config BOARD_TC_BAIT_P3
	bool "TRUCKS CONTROL BAIT Prototype 3"
	depends on SOC_STM32F091XC
```

## boot/zephyr/boards/arm/tc_ext_p3/Kconfig
```kconfig
# Kconfig - TC Ext P3 board configuration
#

if BOARD_TC_EXT_P3

config TC_HAS_GPS
	bool "Enable GPS on this board variant"
	select UART_3
	default n

config TC_HAS_ACCELEROMETER
	bool "Enable accelerometer on this board variant"
	select I2C 
	select I2C_1
	default n

config TC_USER_DEBUG
	bool "Enable user debug uart on this board"
	select UART_4
	default n

config TC_VARIANT_RS485
	bool "Enable user debug uart on this board"
	default n

config TC_FW_UPDATE
	bool "Consider the bootloader is present and enables firmware to load a new image from cable."
	default n

config TC_JIGA_REF
       bool "Flag usada para compilar o código para usar o extensor como placa de refência na jiga de teste."
       default n

endif # BOARD_TC_EXT_P3
```

## boot/zephyr/boards/arm/tc_ext_p3/Kconfig.board
```kconfig
# Kconfig - tc_ext_p1 board configuration
#
# Copyright (c) 2018 Trucks Control
#

config BOARD_TC_EXT_P3
	bool "TC_EXT_P3 Board"
	depends on SOC_STM32F413XX
```

## boot/zephyr/boards/arm/tc_ext_p3/Kconfig.defconfig
```kconfig
# Kconfig - TC_EXT_P3 board configuration
#
# Copyright (c) 2018 Trucks Control
#

if BOARD_TC_EXT_P3

config BOARD
	default "tc_ext_p3"

# GPS
config UART_3
	default n


# Bluetooth
config UART_2
	default y


config UART_4
	default n

# RS232/RS485
config UART_5
	default y

# LoRa 
config UART_6
	default y

config USE_STM32_HAL_PWR
	default y

config RS485
	bool
	default n

if I2C

config I2C_1
	default y

endif # I2C

if SPI

config SPI_1
	default y

endif # SPI

if PWM

config PWM_STM32_2
	default y

endif # PWM

config USB
	default n

config USB_DEVICE_STACK
	default n

config USB_DEVICE_NETWORK_ECM
	default n

endif # TC_EXT_P1
```

## boot/zephyr/boards/arm/tc_ext_p3/tc_ext_p3_defconfig
```kconfig
CONFIG_ARM=y
CONFIG_BOARD_TC_EXT_P3=y
CONFIG_SOC_SERIES_STM32F4X=y
CONFIG_SOC_STM32F413XX=y
# 96MHz system clock (highest value to get a precise USB clock)
CONFIG_SYS_CLOCK_HW_CYCLES_PER_SEC=96000000
CONFIG_SYS_CLOCK_TICKS_PER_SEC=1000

# Enable MPU
CONFIG_ARM_MPU=y

CONFIG_SERIAL=y

# console
CONFIG_CONSOLE=y
CONFIG_UART_CONSOLE=y

#CONFIG_HAS_STM32CUBE=y

# enable pinmux
CONFIG_PINMUX=y

# enable GPIO
CONFIG_GPIO=y

# Clock configuration for Cube Clock control driver
CONFIG_CLOCK_CONTROL=y
#CONFIG_SYS_LOG_CLOCK_CONTROL_LEVEL=0
CONFIG_CLOCK_CONTROL_STM32_CUBE=y
CONFIG_CLOCK_CONTROL_STM32_DEVICE_INIT_PRIORITY=1
# CONFIG_CLOCK_STM32_SYSCLK_SRC_HSI is not set
CONFIG_CLOCK_STM32_SYSCLK_SRC_PLL=y
CONFIG_CLOCK_STM32_PLL_SRC_HSI=y
CONFIG_CLOCK_STM32_PLL_M_DIVISOR=8
CONFIG_CLOCK_STM32_PLL_N_MULTIPLIER=192
CONFIG_CLOCK_STM32_PLL_P_DIVISOR=4
CONFIG_CLOCK_STM32_PLL_Q_DIVISOR=2
CONFIG_CLOCK_STM32_AHB_PRESCALER=1
CONFIG_CLOCK_STM32_APB1_PRESCALER=2
CONFIG_CLOCK_STM32_APB2_PRESCALER=1
```
