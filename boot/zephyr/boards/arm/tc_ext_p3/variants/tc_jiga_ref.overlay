/ {
	model = "Trucks Control Extensor Board Prototype 02";
	compatible = "st,stm32f413";

	chosen {
		zephyr,console = &uart4;
		zephyr,shell-uart = &uart4;
		zephyr,uart-mcumgr = &uart4;
		zephyr,uart-pipe = &uart4;
		zephyr,sram = &sram0;
		zephyr,flash = &flash0;
		zephyr,code-partition = &primary_slot_partition;
	};
};

&uart4 { // User Debug
	current-speed = <115200>;
	pinctrl-0 = <&uart4_pins_c>;
	pinctrl-names = "default";
	status = "ok";
};
